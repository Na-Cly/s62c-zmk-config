## boards/shields/s62c/Kconfig.defconfig
```kconfig
if SHIELD_S62C

# Name must be less than 16 characters long!
config ZMK_KEYBOARD_NAME
    default "S62C"

endif
```

## config/west.yml
```yaml
manifest:
  remotes:
    - name: zmkfirmware
      url-base: https://github.com/zmkfirmware
    - name: badjeff
      url-base: https://github.com/badjeff
  projects:
    - name: zmk
      remote: zmkfirmware
      revision: main
      import: app/west.yml
    # START #####
    - name: zmk-behavior-key-tempo
      remote: badjeff
      revision: main
    # END #######
  self:
    path: config
```
